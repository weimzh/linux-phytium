## drivers/extra/Kconfig
```kconfig
config EXTRA
	bool "Extra drivers"
	default y
	---help---
	  If you have a hardware belonging to this class, say Y.

	  Note that the answer to this question doesn't directly affect the
	  kernel: saying N will just cause the configurator to skip all the
	  questions about these cards. If you say Y, you will be asked for
	  your specific card in the following questions.

if EXTRA
source "drivers/extra/rtl8821ce/Kconfig"
source "drivers/extra/ft8042/Kconfig"
source "drivers/extra/gwnb/Kconfig"
endif
```

## drivers/extra/gwnb/Kconfig
```kconfig
config GWNB
	tristate "GreatWall Notebook EC"
	---help---
	  Help message of GWNB
```
